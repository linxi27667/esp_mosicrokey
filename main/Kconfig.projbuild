## main/Kconfig.projbuild
```kconfig
rsource "../third_party/xiaozhi/main/Kconfig.projbuild"

menu "MosiCrokey hardware"
choice MOSI_LCD_CONTROLLER
    prompt "TFT controller (128x160 portrait / 160x128 landscape)"
    default MOSI_LCD_ST7789
config MOSI_LCD_ST7789
    bool "ST7789"
config MOSI_LCD_ST7735
    bool "ST7735R"
endchoice
config MOSI_LCD_CLK
    int "TFT SCLK GPIO"
    default 43
config MOSI_LCD_MOSI
    int "TFT MOSI GPIO"
    default 44
config MOSI_LCD_CS
    int "TFT CS GPIO"
    default 45
config MOSI_LCD_DC
    int "TFT DC GPIO"
    default 46
config MOSI_LCD_RST
    int "TFT RESET GPIO"
    default 47
config MOSI_LCD_BL
    int "Backlight control GPIO (-1: module powered backlight)"
    range -1 61
    default -1
config MOSI_LCD_SPI_HZ
    int "TFT SPI clock in Hz"
    range 1000000 20000000
    default 10000000
config MOSI_LCD_X_OFFSET
    int "TFT horizontal offset"
    range 0 160
    default 0
config MOSI_LCD_Y_OFFSET
    int "TFT vertical offset"
    range 0 160
    default 0
config MOSI_LCD_INVERT
    bool "Invert panel colors"
    default n
config MOSI_LCD_BGR
    bool "Panel uses BGR color order"
    default y
config MOSI_LCD_ROTATE_180
    bool "Rotate landscape by 180 degrees"
    default n
config MOSI_LCD_BL_ACTIVE_LOW
    bool "Backlight control is active low"
    default n
endmenu
```

## sdkconfig.defaults
```kconfig
CONFIG_IDF_TARGET="esp32s31"
CONFIG_COMPILER_OPTIMIZATION_SIZE=y
CONFIG_COMPILER_CXX_EXCEPTIONS=n
CONFIG_COMPILER_CXX_RTTI=n
CONFIG_ESPTOOLPY_FLASHSIZE_16MB=y
CONFIG_ESPTOOLPY_FLASHMODE_QIO=y
CONFIG_ESPTOOLPY_FLASHFREQ_80M=y
CONFIG_PARTITION_TABLE_CUSTOM=y
CONFIG_PARTITION_TABLE_CUSTOM_FILENAME="partitions.csv"
CONFIG_ESP_DEFAULT_CPU_FREQ_MHZ_320=y
CONFIG_SPIRAM=y
CONFIG_SPIRAM_MODE_OCT=y
CONFIG_SPIRAM_SPEED_200M=y
CONFIG_SPIRAM_MALLOC_ALWAYSINTERNAL=1024
CONFIG_SPIRAM_MALLOC_RESERVE_INTERNAL=102400
CONFIG_MBEDTLS_EXTERNAL_MEM_ALLOC=y
CONFIG_MBEDTLS_DYNAMIC_BUFFER=y
CONFIG_MBEDTLS_CERTIFICATE_BUNDLE=y
CONFIG_ESP_MAIN_TASK_STACK_SIZE=8192
CONFIG_ESP_TASK_WDT_TIMEOUT_S=10
CONFIG_FREERTOS_HZ=1000
CONFIG_FREERTOS_GENERATE_RUN_TIME_STATS=y
CONFIG_FREERTOS_USE_STATS_FORMATTING_FUNCTIONS=y
CONFIG_ESP_WIFI_STATIC_RX_BUFFER_NUM=3
CONFIG_ESP_WIFI_DYNAMIC_RX_BUFFER_NUM=6
CONFIG_ESP_WIFI_RX_BA_WIN=3
CONFIG_LWIP_TCPIP_RECVMBOX_SIZE=16
CONFIG_HTTPD_MAX_REQ_HDR_LEN=2048
CONFIG_HTTPD_MAX_URI_LEN=2048
CONFIG_FATFS_LFN_HEAP=y
CONFIG_FATFS_MAX_LFN=128
CONFIG_FATFS_FS_LOCK=12
CONFIG_FATFS_TIMEOUT_MS=1000
CONFIG_LANGUAGE_ZH_CN=y
CONFIG_BOARD_TYPE_ESP32_S31_FUNCTION_COREBOARD_1=y
CONFIG_USE_AUDIO_PROCESSOR=y
CONFIG_USE_DEVICE_AEC=n
CONFIG_USE_SERVER_AEC=n
CONFIG_SR_WN_WN9_NIHAOXIAOZHI_TTS=y
CONFIG_LV_OS_NONE=y
CONFIG_LV_USE_CLIB_MALLOC=y
CONFIG_LV_USE_CLIB_STRING=y
CONFIG_LV_USE_CLIB_SPRINTF=y
CONFIG_LV_USE_SNAPSHOT=y
CONFIG_LV_USE_CANVAS=y
CONFIG_LV_FONT_MONTSERRAT_12=y
CONFIG_LV_FONT_FMT_TXT_LARGE=y
CONFIG_LUA_MAXSTACK=4096
CONFIG_LV_USE_LODEPNG=y
CONFIG_LV_BUILD_EXAMPLES=n
CONFIG_LV_BUILD_DEMOS=n
CONFIG_CODEC_I2C_BACKWARD_COMPATIBLE=n
CONFIG_LWIP_TCPIP_TASK_AFFINITY_CPU0=y
```
